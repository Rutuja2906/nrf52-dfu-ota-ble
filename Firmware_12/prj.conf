## CMakeLists.txt
```
# SPDX-License-Identifier: Apache-2.0

cmake_minimum_required(VERSION 3.20.0)
set(mcuboot_CONFIG_BOOT_SIGNATURE_TYPE_ECDSA_P256 y)
set(mcuboot_CONFIG_BOOT_SIGNATURE_KEY_FILE \"${CMAKE_CURRENT_SOURCE_DIR}/priv.pem\")
#set(PM_STATIC_YML_FILE \"${CMAKE_CURRENT_SOURCE_DIR}/pm_static.yml\")
find_package(Zephyr REQUIRED HINTS $ENV{ZEPHYR_BASE})
project(Firmware_12)

target_sources(app PRIVATE src/main.c)
```

## prj.conf
```kconfig
# nothing here
CONFIG_LOG=y

#Enabling ZCBOR (Zero-Copy Binary Object Representation)
CONFIG_ZCBOR=y

#FLASH 
CONFIG_FLASH=y
CONFIG_FLASH_MAP=y
CONFIG_IMG_MANAGER=y
CONFIG_STREAM_FLASH=y
#CONFIG_FLASH_PAGE_LAYOUT=y
#CONFIG_FLASH_HAS_DRIVER_ENABLED=y

# BLE related
CONFIG_BT=y
#CONFIG_BT_HCI=y
CONFIG_BT_PERIPHERAL=y
CONFIG_BT_DEVICE_NAME="RUTUJA's BLE-1"
CONFIG_BT_FILTER_ACCEPT_LIST=y
CONFIG_BT_SMP=y #Secure Manager Protocol
CONFIG_BT_FIXED_PASSKEY=y
CONFIG_BT_BONDING_REQUIRED=y
CONFIG_BT_DEVICE_APPEARANCE=832
#CONFIG_BT_DIS=y
CONFIG_SETTINGS=y
CONFIG_BT_SIGNING=y
CONFIG_BT_ATT_PREPARE_COUNT=1
CONFIG_BT_PRIVACY=y
CONFIG_BT_SETTINGS=y
CONFIG_FLASH_PAGE_LAYOUT=y

CONFIG_BT_L2CAP_TX_MTU=498
CONFIG_BT_BUF_ACL_TX_SIZE=251
CONFIG_BT_BUF_ACL_RX_SIZE=502
CONFIG_BT_CTLR_DATA_LENGTH_MAX=251
CONFIG_NVS=y
CONFIG_SETTINGS_NVS=y

#MCUMGR
CONFIG_MCUMGR=y
CONFIG_MCUMGR_GRP_IMG=y
CONFIG_MCUMGR_GRP_OS=y

# Enabling Bluetooth as a transport protocol for the MCUMGR
CONFIG_MCUMGR_TRANSPORT_BT=y

# Enabled Authentication (Secured DFU considered)
CONFIG_MCUMGR_TRANSPORT_BT_AUTHEN=y

#Allowed building and compiling of Bootloader and application, then they get merged into hex file
CONFIG_BOOTLOADER_MCUBOOT=y

# Enable the LBS service
CONFIG_DK_LIBRARY=y

#Increase the number of maximum paired devices
CONFIG_BT_MAX_PAIRED=1

# Increase stack size for the main thread and System Workqueue
#CONFIG_SYSTEM_WORKQUEUE_PRIORITY=-1
CONFIG_SYSTEM_WORKQUEUE_STACK_SIZE=4096
CONFIG_MAIN_STACK_SIZE=4096
CONFIG_LOG_BUFFER_SIZE=2048

CONFIG_NCS_SAMPLE_MCUMGR_BT_OTA_DFU=y

#CONFIG_BT_DEBUG_HCI_DRIVER=y
```

## src/main.c
```c
#include <zephyr/kernel.h>
#include <zephyr/logging/log.h>
#include <zephyr/drivers/gpio.h>
#include <zephyr/device.h>

#include <zephyr/types.h>
#include <stddef.h>
#include <string.h>
#include <errno.h>
#include <zephyr/sys/printk.h>
#include <zephyr/sys/reboot.h>
#include <zephyr/settings/settings.h>
#include <zephyr/sys/byteorder.h>
#include <soc.h>

#include <zephyr/bluetooth/bluetooth.h>
#include <zephyr/bluetooth/conn.h>
#include <zephyr/bluetooth/gatt.h>
#include <zephyr/bluetooth/uuid.h>
#include <zephyr/bluetooth/services/dis.h>
#include <zephyr/bluetooth/hci.h>
#include <dk_buttons_and_leds.h>
#include <inttypes.h>

#include <zephyr/mgmt/mcumgr/transport/smp_bt.h>
// #include <zephyr/sys/crc.h>

LOG_MODULE_REGISTER(DFU, LOG_LEVEL_INF);

// Custom 128-bit UUID
#define BT_UUID_HEALTH_STATUS_VAL \
    BT_UUID_128_ENCODE(0x12345678, 0x9abc, 0xdef0, 0x1234, 0x56789abcdef0)

static struct bt_uuid_128 health_status_uuid = BT_UUID_INIT_128(BT_UUID_HEALTH_STATUS_VAL);

// Status strings
static const char *status_strings[] = {
    "OK", "Mild", "Critical", "Sensor Error"
};

static uint8_t current_status_index = 0;
static uint8_t last_sent_index = 0xFF;

static struct k_work_delayable health_notify_work;


// Read handler
static ssize_t read_health_status(struct bt_conn *conn,
                                  const struct bt_gatt_attr *attr,
                                  void *buf, uint16_t len, uint16_t offset)
{
    const char *status = status_strings[current_status_index];
    return bt_gatt_attr_read(conn, attr, buf, len, offset, status, strlen(status));
}

// GATT service
BT_GATT_SERVICE_DEFINE(health_svc,
    BT_GATT_PRIMARY_SERVICE(&health_status_uuid),
    BT_GATT_CHARACTERISTIC(&health_status_uuid.uuid,
                           BT_GATT_CHRC_READ | BT_GATT_CHRC_NOTIFY,
                           BT_GATT_PERM_READ,
                           read_health_status, NULL, "Health Service"),
    BT_GATT_CCC(NULL, BT_GATT_PERM_READ | BT_GATT_PERM_WRITE)
);

/* 1000 msec = 1 sec */
#define SLEEP_TIME_MS 1000

#define DEVICE_NAME CONFIG_BT_DEVICE_NAME
#define DEVICE_NAME_LEN (sizeof(DEVICE_NAME) - 1)

#define MAX_ACCEPT_LIST_SIZE 1

struct accept_list_storage
{
	bt_addr_le_t addr[MAX_ACCEPT_LIST_SIZE];
	int count;
};

static struct accept_list_storage accept_list;
static int accept_list_settings_set(const char *name, size_t len,
									settings_read_cb read_cb, void *cb_arg)
{
	const char *next;
	int rc;

	if (settings_name_steq(name, "accept_list", &next) && !next)
	{
		if (len != sizeof(accept_list))
		{
			return -EINVAL;
		}

		rc = read_cb(cb_arg, &accept_list, sizeof(accept_list));
		if (rc >= 0)
		{
			return 0;
		}

		return rc;
	}

	return -ENOENT;
}

static int save_accept_list(void)
{
	int err = settings_save_one("your_namespace/accept_list", &accept_list, sizeof(accept_list));
	if (err)
	{
		LOG_INF("Failed to save accept list (err %d)\n", err);
	}
	else
	{
		LOG_INF("Accept list saved\n");
	}
	return err;
}

struct settings_handler accept_list_conf = {
	.name = "your_namespace",
	.h_set = accept_list_settings_set,
};
// #define CON_STATUS_LED DK_LED3
// Led blinking
#define LED0_NODE DT_ALIAS(led0)
static const struct gpio_dt_spec led = GPIO_DT_SPEC_GET(LED0_NODE, gpios);

#define RUN_LED_BLINK_INTERVAL 1000

/* Add extra button for bond deleting function */

#define BOND_DELETE_BUTTON DK_BTN2_MSK

/* Add extra button for enablig pairing mode */

#define PAIRING_BUTTON DK_BTN3_MSK

void notify_central_device(struct bt_conn *conn, const struct bt_gatt_attr *attr)
{
	/* Your data to send to the central device */
	uint8_t data[] = {0x01, 0x02, 0x03, 0x04};

	/* Notify the central device */
	int err = bt_gatt_notify(conn, attr, data, sizeof(data));
	if (err)
	{
		printk("Failed to send notification: %d\n", err);
	}
	else
	{
		printk("Sent notification to central device\n");
	}
}
/* Advertising parameter for no Accept List */
#define BT_LE_ADV_CONN_NO_ACCEPT_LIST BT_LE_ADV_PARAM(BT_LE_ADV_OPT_CONNECTABLE | BT_LE_ADV_OPT_ONE_TIME, BT_GAP_ADV_FAST_INT_MIN_2, BT_GAP_ADV_FAST_INT_MAX_2, NULL)

/* Advertising parameter for when Accept List is used */
#define BT_LE_ADV_CONN_ACCEPT_LIST BT_LE_ADV_PARAM(BT_LE_ADV_OPT_CONNECTABLE | BT_LE_ADV_OPT_FILTER_CONN | BT_LE_ADV_OPT_ONE_TIME, BT_GAP_ADV_FAST_INT_MIN_2, BT_GAP_ADV_FAST_INT_MAX_2, NULL)

static const struct bt_data ad[] = {
	BT_DATA_BYTES(BT_DATA_FLAGS, (BT_LE_AD_GENERAL | BT_LE_AD_NO_BREDR)),
	BT_DATA(BT_DATA_NAME_COMPLETE, DEVICE_NAME, DEVICE_NAME_LEN)};

static const struct bt_data sd[] = {
	BT_DATA_BYTES(BT_DATA_UUID16_ALL, BT_UUID_16_ENCODE(BT_UUID_DIS_VAL)),
};

/* The callback function to add addreses to the Accept List */
static void setup_accept_list_cb(const struct bt_bond_info *info, void *user_data)
{
	int *bond_cnt = user_data;

	if ((*bond_cnt) < 0)
	{
		return;
	}

	int err = bt_le_filter_accept_list_add(&info->addr);
	LOG_INF("Added following peer to accept list: %x %x\n", info->addr.a.val[0],
			info->addr.a.val[1]);
	if (err)
	{
		LOG_INF("Cannot add peer to filter accept list (err: %d)\n", err);
		(*bond_cnt) = -EIO;
	}
	else
	{
		(*bond_cnt)++;
	}
}

/* The function to loop through the bond list */
static int setup_accept_list(uint8_t local_id)
{
	// int err = bt_le_filter_accept_list_clear();
	bt_le_filter_accept_list_clear();
	// if (err) {
	//	LOG_INF("Cannot clear accept list (err: %d)\n", err);
	//	return err;
	// }
	int bond_cnt = 0;
	bt_foreach_bond(local_id, setup_accept_list_cb, &bond_cnt);
	accept_list.count = bond_cnt;
	LOG_INF("Setup accept list(bound count: %d)\n", bond_cnt);
	save_accept_list();
	return bond_cnt;
}

// Notification logic
void update_health_status(uint8_t new_status_index)
{
    if (new_status_index >= ARRAY_SIZE(status_strings)) {
        LOG_ERR("Invalid status index: %d", new_status_index);
        return;
    }

    current_status_index = new_status_index;

    if (current_status_index != last_sent_index) {
        const char *status_str = status_strings[current_status_index];
        int err = bt_gatt_notify(NULL, &health_svc.attrs[1], status_str, strlen(status_str));
        if (err) {
            LOG_ERR("Notify failed (%d)", err);
        } else {
            LOG_INF("Health status updated: %s", status_str);
            last_sent_index = current_status_index;
        }
    }
}

// Workqueue handler
void health_notify_work_handler(struct k_work *work)
{
    static uint8_t fake_status = 0;

    update_health_status(fake_status);
    fake_status = (fake_status + 1) % ARRAY_SIZE(status_strings);

    k_work_schedule(&health_notify_work, K_SECONDS(5));
}


/* The function to advertise with the Accept List */
void advertise_with_acceptlist(struct k_work *work)
{
	int err = 0;
	int allowed_cnt = setup_accept_list(BT_ID_DEFAULT);
	if (allowed_cnt < 0)
	{
		LOG_INF("Acceptlist setup failed (err:%d)\n", allowed_cnt);
	}
	else
	{
		if (allowed_cnt == 0)
		{
			LOG_INF("Advertising with no Accept list \n");
			err = bt_le_adv_start(BT_LE_ADV_CONN_NO_ACCEPT_LIST, ad, ARRAY_SIZE(ad), sd,
								  ARRAY_SIZE(sd));
		}
		else
		{
			LOG_INF("Acceptlist setup number  = %d \n", allowed_cnt);
			err = bt_le_adv_start(BT_LE_ADV_CONN_ACCEPT_LIST, ad, ARRAY_SIZE(ad), sd,
								  ARRAY_SIZE(sd));
		}
		if (err)
		{
			LOG_INF("Advertising failed to start (err %d)\n", err);
			return;
		}
		LOG_INF("Advertising successfully started\n");
	}
	// Reinitialize the work item so it can be resubmitted in the future.
	k_work_init(work, advertise_with_acceptlist);
}
K_WORK_DEFINE(advertise_acceptlist_work, advertise_with_acceptlist);

static bool bt_conn_is_bonded(struct bt_conn *conn)
{
	bt_addr_le_t addr;
	bt_addr_le_copy(&addr, bt_conn_get_dst(conn));

	int allowed_cnt = setup_accept_list(BT_ID_DEFAULT);
	return allowed_cnt > 0;
}

static void on_connected(struct bt_conn *conn, uint8_t err)
{
	if (err)
	{
		LOG_INF("Connection failed (err %u)\n", err);
		return;
	}
	// Check if the device is already bonded
	if (!bt_conn_is_bonded(conn))
	{
		// Set security level to require passkey if not bonded
		err = bt_conn_set_security(conn, BT_SECURITY_L4);
		if (err)
		{
			LOG_INF("Failed to set security level (err %d)\n", err);

			// Disconnect the device if setting security fails
			int ret = bt_conn_disconnect(conn, BT_HCI_ERR_REMOTE_USER_TERM_CONN);
			if (ret)
			{
				LOG_ERR("Failed to disconnect: %d\n", ret);
			}
			else
			{
				LOG_INF("Disconnected device due to security failure\n");
			}
			return; // Exit the function after disconnecting
		}
	}
	else
	{
		LOG_INF("Device is already bonded");
	}

	// Set preferred connection parameters
	struct bt_le_conn_param *conn_params = BT_LE_CONN_PARAM(6, 6, 0, 400); // Adjust as necessary
	err = bt_conn_le_param_update(conn, conn_params);
	if (err)
	{
		LOG_ERR("Failed to update connection parameters: %d\n", err);
	}
	else
	{
		LOG_INF("Connection parameters updated successfully");
	}
	// dk_set_led_on(CON_STATUS_LED);// Turn on LED 2
}

static void on_disconnected(struct bt_conn *conn, uint8_t reason)
{
	LOG_INF("Disconnected (reason %u)\n", reason);
	// dk_set_led_off(CON_STATUS_LED); // Turn off LED 2

	LOG_INF("Submitting advertise_acceptlist_work_disconnect Mode");

	if (!k_work_is_pending(&advertise_acceptlist_work))
	{
		int err = k_work_submit(&advertise_acceptlist_work);
		if (err)
		{
			printk("Failed to submit advertise_acceptlist_work _disconnected mode (err %d)\n", err);
		}
	}
	else
	{
		printk("Work is already pending\n");
	}
}

// Security changed to Passkey based security
static void on_security_changed(struct bt_conn *conn, bt_security_t level, enum bt_security_err err)
{

	char addr[BT_ADDR_LE_STR_LEN];
	bt_addr_le_to_str(bt_conn_get_dst(conn), addr, sizeof(addr));

	if (!err)
	{
		LOG_INF("Security changed: %s level %u\n", addr, level);

		if (level < BT_SECURITY_L4)
		{
			LOG_ERR("Security level is too low! Expected Level 4");
		}
	}
	else
	{
		LOG_INF("Security failed: %s level %u err %d\n", addr, level, err);
		
		// Disconnect the device if security fails
		int ret = bt_conn_disconnect(conn, BT_HCI_ERR_REMOTE_USER_TERM_CONN);
		if (ret) {
			LOG_ERR("Failed to disconnect: %d\n", ret);
		} else {
			LOG_INF("Disconnected device: %s\n", addr);

		}
	}
	/*
	char addr[BT_ADDR_LE_STR_LEN];
	bt_addr_le_to_str(bt_conn_get_dst(conn), addr, sizeof(addr));
	if (!err) {
		LOG_INF("Security changed: %s level %u\n", addr, level);
	} else {
		LOG_INF("Security failed: %s level %u err %d\n", addr, level, err);


		// Disconnect the device if security fails
		int ret = bt_conn_disconnect(conn, BT_HCI_ERR_REMOTE_USER_TERM_CONN);
		if (ret) {
			LOG_ERR("Failed to disconnect: %d\n", ret);
		} else {
			LOG_INF("Disconnected device: %s\n", addr);

		}

	}*/
}

struct bt_conn_cb connection_callbacks = {
	.connected = on_connected,
	.disconnected = on_disconnected,
	.security_changed = on_security_changed,
};
static void auth_passkey_display(struct bt_conn *conn, unsigned int passkey)
{
	char addr[BT_ADDR_LE_STR_LEN];
	bt_addr_le_to_str(bt_conn_get_dst(conn), addr, sizeof(addr));
	LOG_INF("Passkey for %s: %06u\n", addr, passkey);
}
static void auth_cancel(struct bt_conn *conn)
{
	char addr[BT_ADDR_LE_STR_LEN];
	bt_addr_le_to_str(bt_conn_get_dst(conn), addr, sizeof(addr));
	LOG_INF("Pairing cancelled: %s\n", addr);
}
static void pairing_confirm(struct bt_conn *conn)
{
	char addr[BT_ADDR_LE_STR_LEN];
	bt_addr_le_to_str(bt_conn_get_dst(conn), addr, sizeof(addr));
	bt_conn_auth_pairing_confirm(conn);
	printk("Pairing confirmed: %s\n", addr);
}

static struct bt_conn_auth_cb conn_auth_callbacks = {
	.passkey_display = auth_passkey_display,
	.cancel = auth_cancel,
	.pairing_confirm = pairing_confirm};

static void button_changed(uint32_t button_state, uint32_t has_changed)
{
	/* Add extra button handling to remove bond information */
	if (has_changed & BOND_DELETE_BUTTON)
	{
		uint32_t bond_delete_button_state = button_state & BOND_DELETE_BUTTON;
		if (bond_delete_button_state == 0)
		{
			int err = bt_unpair(BT_ID_DEFAULT, BT_ADDR_LE_ANY);
			if (err)
			{
				LOG_INF("Cannot delete bond (err: %d)\n", err);
			}
			else
			{
				LOG_INF("Bond deleted succesfully");
			}
		}
	}

	/* Add extra button handling to advertise without using Accept List */
	if (has_changed & PAIRING_BUTTON)
	{
		uint32_t pairing_button_state = button_state & PAIRING_BUTTON;
		if (pairing_button_state == 0)
		{
			int err_code = bt_le_adv_stop();
			if (err_code)
			{
				LOG_INF("Cannot stop advertising err= %d \n", err_code);
				return;
			}
			err_code = bt_le_filter_accept_list_clear();
			if (err_code)
			{
				LOG_INF("Cannot clear accept list (err: %d)\n", err_code);
			}
			else
			{
				LOG_INF("Accept list cleared succesfully");
			}
			err_code = bt_le_adv_start(BT_LE_ADV_CONN_NO_ACCEPT_LIST, ad,
									   ARRAY_SIZE(ad), sd, ARRAY_SIZE(sd));

			if (err_code)
			{
				LOG_INF("Cannot start open advertising (err: %d)\n", err_code);
			}
			else
			{
				LOG_INF("Advertising in pairing mode started");
			}
		}
	}
}
static int init_button(void)
{
	int err;
	err = dk_buttons_init(button_changed);
	if (err)
	{
		LOG_INF("Cannot init buttons (err: %d)\n", err);
	}
	return err;
}

int main(void)
{
	printk("Board: %s\n", CONFIG_BOARD);
	printk("Build time:  " __TIME__ "\n");

	int err;
	int ret;

	LOG_INF("DFU firmware 1\n");

	err = dk_leds_init();
	if (err)
	{
		LOG_INF("LEDs init failed (err %d)\n", err);
		return err;
	}
	err = init_button();
	if (err)
	{
		LOG_INF("Button init failed (err %d)\n", err);
		return err;
	}

	err = bt_enable(NULL);
	if (err)
	{
		LOG_INF("Bluetooth init failed (err %d)\n", err);
		return err;
	}

	LOG_INF("Initialized BLE\n");
	settings_subsys_init();
	settings_register(&accept_list_conf);
	ret = settings_load(); // Load the accept list
	if (ret == 0)
	{
		LOG_INF("advertise_acceptlist_work loaded successfully");
	}
	else
	{
		LOG_INF("Failed to load advertise_acceptlist_work (err %d)", ret);
	}

	if (!k_work_is_pending(&advertise_acceptlist_work))
	{
		k_work_submit(&advertise_acceptlist_work);
		// if (err) {
		//     printk("Failed to submit work (err %d)\n", err);
		// }
		// } else {
		// printk("Work is already pending\n");
	}

	/* Optional: Print the current accept list (after settings are loaded) */
	int bond_count = setup_accept_list(BT_ID_DEFAULT);
	if (bond_count >= 0)
	{
		LOG_INF("Number of bonded devices in accept list: %d", bond_count);
	}
	else
	{
		LOG_ERR("Error setting up accept list after settings load (err: %d)", bond_count);
	}

	bt_conn_cb_register(&connection_callbacks);
	unsigned int passkey = 123456;
	err = bt_conn_auth_cb_register(&conn_auth_callbacks);
	if (err)
	{
		LOG_INF("Failed to register authorization callbacks.:%d\n", err);
		return err;
	}
	else
	{
		LOG_INF("register authorization callbacks successed.:%d\n", err);
	}
	bt_passkey_set(passkey);

	if (!gpio_is_ready_dt(&led))
	{
		return 0;
	}

	ret = gpio_pin_configure_dt(&led, GPIO_OUTPUT_ACTIVE);
	if (ret < 0)
	{
		return 0;
	}
	printk("Build end time:  " __TIME__ "\n");
	
    k_work_init_delayable(&health_notify_work, health_notify_work_handler);
    k_work_schedule(&health_notify_work, K_SECONDS(5));

	while (1)
	{
		ret = gpio_pin_toggle_dt(&led);
		if (ret < 0)
		{
			return 0;
			printk("");
		}
		k_msleep(SLEEP_TIME_MS);
	}
}
```
